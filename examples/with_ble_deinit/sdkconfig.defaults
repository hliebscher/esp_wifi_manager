## examples/with_ble_deinit/sdkconfig.defaults
```kconfig
CONFIG_IDF_TARGET="esp32s3"

# Use larger partition table for BLE (requires 4MB+ flash)
CONFIG_PARTITION_TABLE_SINGLE_APP_LARGE=y

# BLE Configuration — NimBLE (lighter than Bluedroid)
CONFIG_BT_ENABLED=y
CONFIG_BT_NIMBLE_ENABLED=y
CONFIG_BT_NIMBLE_HOST_TASK_STACK_SIZE=6144

# WiFi Manager BLE
CONFIG_WIFI_MGR_ENABLE_BLE=y
CONFIG_WIFI_MGR_BLE_DEVICE_NAME="ESP32-WiFi-{id}"
```
